## conf/layer.conf
```bitbake
# We have a conf directory, append to BBPATH
BBPATH .= ":${LAYERDIR}"

# We have a recipes directory, add to BBFILES
BBFILES += " \
  ${LAYERDIR}/recipes*/*/*.bb \
  ${LAYERDIR}/recipes*/*/*.bbappend \
"

BBFILE_COLLECTIONS += "meta-gumstix-community"
BBFILE_PATTERN_meta-gumstix-community := "^${LAYERDIR}/"
BBFILE_PRIORITY_meta-gumstix-community = "7"

LAYERDEPENDS_meta-gumstix-community = "core"
LAYERSERIES_COMPAT_meta-gumstix-community = "rocko sumo"
```

## conf/machine/include/omap3.inc
```bitbake
SOC_FAMILY = "omap3"
require conf/machine/include/soc-family.inc
require conf/machine/include/tune-cortexa8.inc

UBOOT_ARCH = "arm"
UBOOT_ENTRYPOINT = "0x80008000"
UBOOT_LOADADDRESS = "0x80008000"
```

## conf/machine/overo.conf
```bitbake
#@TYPE: Machine
#@NAME: overo machine
#@DESCRIPTION: Machine configuration for the Gumstix Overo

require include/omap3.inc

###############################################################################
# u-boot
EXTRA_IMAGEDEPENDS = "u-boot-overo"
PREFERRED_PROVIDER_virtual/bootloader = "u-boot-overo"
UBOOT_MACHINE = "omap3_overo_config"

###############################################################################
# kernel

PREFERRED_PROVIDER_virtual/kernel               = "linux-mainline-3.14"

SERIAL_CONSOLE = "115200 ttyO2"

###############################################################################
# X
PREFERRED_PROVIDER_virtual/xserver = "xserver-xorg"
XSERVER = "xserver-xorg \
           xf86-input-evdev \
           xf86-input-mouse \
           xf86-input-keyboard \
           xf86-input-tslib \
           \
           xf86-video-omapfb \
           \
           xf86-video-omap \
           xserver-xorg-module-exa \
           \
           xf86-video-modesetting \
           \
           xf86-video-fbdev \
"

###############################################################################
# UBI
# do ubiattach /dev/ubi_ctrl -m 4
# From dmesg:
# UBI: smallest flash I/O unit:    2048
# UBI: logical eraseblock size:    129024 bytes
# from ubiattach stdout:
# UBI device number 0, total 1996 LEBs
MKUBIFS_ARGS = "-m 2048 -e 129024 -c 1996"

# do ubiattach /dev/ubi_ctrl -m 4
# from dmesg:
# UBI: smallest flash I/O unit:    2048
# UBI: physical eraseblock size:   131072 bytes (128 KiB)
# UBI: sub-page size:              512
UBINIZE_ARGS = "-m 2048 -p 128KiB -s 512"
UBI_VOLNAME = "rootfs"

###############################################################################
# misc
GUI_MACHINE_CLASS = "bigscreen"

IMAGE_FSTYPES += "tar.bz2"
# IMAGE_FSTYPES += "ubi tar.bz2"

MACHINE_EXTRA_RRECOMMENDS = "kernel-modules linux-firmware-sd8686 udev-udisks-rules-overo"
#task-ti-drivers libgles-omap3

MACHINE_FEATURES = "kernel26 alsa apm ext2 screen usbgadget usbhost vfat"
# touchscreen

PREFERRED_PROVIDER_virtual/libgl = "mesa-gl"
PREFERRED_PROVIDER_virtual/egl = "gles-omap3"
PREFERRED_PROVIDER_virtual/libgles1 = "gles-omap3"
PREFERRED_PROVIDER_virtual/libgles2 = "gles-omap3"
PREFERRED_PROVIDER_virtual/mesa = "mesa-gl"
# for cogl's sake
PREFERRED_PROVIDER_libgles2 = "gles-omap3"
```
